## main/Kconfig.projbuild
```kconfig
menu "LK ICS2 Matter Bridge Configuration"

    config LK_ICS2_UART_PORT
        int "RS485 UART Port Number"
        default 1
        range 0 2
        help
            UART port number connected to the RS485 transceiver.
            ESP32-C6: UART0 is reserved for console, use UART1.

    config LK_ICS2_UART_TX_PIN
        int "RS485 UART TX GPIO Pin"
        default 6
        range 0 22
        help
            GPIO pin for UART TX (connected to RS485 DI pin).

    config LK_ICS2_UART_RX_PIN
        int "RS485 UART RX GPIO Pin"
        default 7
        range 0 22
        help
            GPIO pin for UART RX (connected to RS485 RO pin).

    config LK_ICS2_RS485_DE_PIN
        int "RS485 Driver Enable (DE/RE) GPIO Pin"
        default 10
        range 0 22
        help
            GPIO pin for RS485 DE/RE (Driver Enable / Receiver Enable).
            Connect both DE and /RE of the transceiver to this pin.
            High = transmit, Low = receive.

    config LK_ICS2_MODBUS_BAUD_RATE
        int "Modbus Baud Rate"
        default 9600
        help
            RS485 Modbus RTU baud rate. The LK ICS 2 default is 9600 baud.

    config LK_ICS2_MODBUS_SLAVE_ADDR
        int "Modbus Slave Address"
        default 1
        range 1 247
        help
            Modbus RTU slave address of the LK ICS 2 controller.
            Default address is 1. Check the ICS 2 configuration.

    config LK_ICS2_NUM_ZONES
        int "Number of Heating Zones"
        default 6
        range 1 12
        help
            Number of heating zones to expose as Matter thermostat endpoints.
            The LK ICS 2 supports up to 12 zones.

    config LK_ICS2_POLL_INTERVAL_MS
        int "Zone Poll Interval (ms)"
        default 5000
        range 1000 60000
        help
            How often to poll the LK ICS 2 for temperature and state updates (milliseconds).

    config LK_ICS2_MODBUS_TIMEOUT_MS
        int "Modbus Response Timeout (ms)"
        default 500
        range 100 5000
        help
            Timeout waiting for a Modbus RTU response from the LK ICS 2.

endmenu
```

## sdkconfig.defaults
```kconfig
# Target board and SoC
CONFIG_IDF_TARGET="esp32c6"

# OpenThread + Matter over Thread + BLE commissioning
CONFIG_OPENTHREAD_ENABLED=y
CONFIG_OPENTHREAD_FTD=y

# Pin OpenThread router-role thresholds explicitly so behaviour is documented
# and stable across SDK/OpenThread upgrades.
CONFIG_OPENTHREAD_MAX_ROUTERS=32
CONFIG_OPENTHREAD_ROUTER_UPGRADE_THRESHOLD=16
CONFIG_OPENTHREAD_ROUTER_DOWNGRADE_THRESHOLD=23

# Persist Thread network credentials across reboots.
CONFIG_OPENTHREAD_NVS_PERSIST=y

# BLE discovery for commissioning
CONFIG_BT_ENABLED=y
CONFIG_BT_NIMBLE_ENABLED=y
CONFIG_ENABLE_CHIPOBLE=y

# Route all Matter credentials to the protected nvs_matter partition.
CONFIG_CHIP_FACTORY_NAMESPACE_PARTITION_LABEL="nvs_matter"
CONFIG_CHIP_CONFIG_NAMESPACE_PARTITION_LABEL="nvs_matter"
CONFIG_ESP_MATTER_NVS_PART_NAME="nvs_matter"

# OTA disabled: no ota_0/ota_1 partitions in this partition table.
CONFIG_ENABLE_OTA_REQUESTOR=n

# Disable CHIP's WiFi NetworkCommissioning driver and WiFi station so that
# only the Thread NetworkCommissioning cluster is advertised to commissioners.
#
# Without these, esp_matter::start() registers both WiFi and Thread clusters
# and Home Assistant may attempt WiFi commissioning even with a Thread Border
# Router available. Also prevents ConnectivityManagerImpl from requiring
# WiFi-specific methods it does not implement in Thread-only builds.
CONFIG_WIFI_NETWORK_COMMISSIONING_DRIVER=n
CONFIG_ENABLE_WIFI_STATION=n

# FreeRTOS tick rate: 1000 Hz gives 1 ms resolution for MRP retransmission
# timers, Thread MLE timeouts, and Matter subscription reporting intervals.
CONFIG_FREERTOS_HZ=1000

# Matter device identity shown in Home Assistant and other controllers.
CONFIG_DEVICE_PRODUCT_NAME="LK Floor heating"

# Matter + logging defaults
CONFIG_ESP_MATTER_ENABLE_DATA_MODEL=y
CONFIG_LOG_DEFAULT_LEVEL=2
CONFIG_OPENTHREAD_LOG_LEVEL_NOTE=y

# mbedTLS features required by esp_matter/CHIP
CONFIG_MBEDTLS_HKDF_C=y

# Custom partition table
CONFIG_PARTITION_TABLE_CUSTOM=y
CONFIG_PARTITION_TABLE_CUSTOM_FILENAME="partitions.csv"

# Flash size (required by custom partition table)
CONFIG_ESPTOOLPY_FLASHSIZE_4MB=y

# Coredump to flash (ELF format for gdb)
CONFIG_ESP_COREDUMP_ENABLE_TO_FLASH=y
CONFIG_ESP_COREDUMP_DATA_FORMAT_ELF=y

# Main task stack: Matter/Thread init path needs >3584 byte default
CONFIG_ESP_MAIN_TASK_STACK_SIZE=8192

# UART ISR in IRAM for reliable RS485 timing under cache pressure
CONFIG_UART_ISR_IN_IRAM=y
```
